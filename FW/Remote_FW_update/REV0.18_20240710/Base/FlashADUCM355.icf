/*###ICF### Section handled by ICF editor, don't touch! ****/
/*-Editor annotation file-*/
/* IcfEditorFile="$TOOLKIT_DIR$\config\ide\IcfEditor\a_v1_0.xml" */
/*-Specials-*/
define symbol __ICFEDIT_intvec_start__ = 0x10000000;  // Bank2 of instruction SRAM in default SRAM Mode0
/*-Memory Regions-*/
define symbol __ICFEDIT_region_ROM_start__ = 0x0;
define symbol __ICFEDIT_region_ROM_end__   = 0x0;
define symbol __ICFEDIT_region_RAM_start__ = 0x10000100;  // leave 256 bytes for IVT
define symbol __ICFEDIT_region_RAM_end__   = 0x10003FFF;  // end of Bank2
/*-Sizes-*/
define symbol __ICFEDIT_size_cstack__      = 0x200;
define symbol __ICFEDIT_size_heap__        = 0x200;
/**** End of ICF editor section. ###ICF###*/

define symbol __dRAM_start__               = 0x20040000;  // Bank3 of data SRAM
define symbol __dRAM_end__                 = 0x20043FFF;  // end of Bank3

define memory mem with size = 4G;
define region iRAM_region   = mem:[from __ICFEDIT_region_RAM_start__   to __ICFEDIT_region_RAM_end__];
define region dRAM_region   = mem:[from __dRAM_start__   to __dRAM_end__];

define block CSTACK    with alignment = 8, size = __ICFEDIT_size_cstack__   { };
define block HEAP      with alignment = 8, size = __ICFEDIT_size_heap__     { };
define block BUFFER    with alignment = 8, size = 8k     { };  // 1/2 of bank3 for download buffer

// KEEP these blocks, avoiding linker elimination...
keep {
	block CSTACK,
	block HEAP,
    block BUFFER,
};

initialize by copy { readwrite };
do not initialize  { section .noinit };

place at address mem:__ICFEDIT_intvec_start__ { section .intvec };

// iRam placements
place at start of iRAM_region { block bank2_iRAM with fixed order {readonly}};

// dRam placements
place at end of   dRAM_region { block bank3_dRAM with fixed order {section LOWEND, block BUFFER, section HIGHSTART, readwrite, section .init, block CSTACK, block HEAP}};
